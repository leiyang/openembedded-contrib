## conf/layer.conf
```bitbake
# We have a conf and classes directory, add to BBPATH
BBPATH := "${BBPATH}:${LAYERDIR}"

# We have a packages directory, add to BBFILES
BBFILES := "${BBFILES} ${LAYERDIR}/recipes-*/*/*.bb \
	    ${LAYERDIR}/recipes-*/*/*.bbappend \
            ${LAYERDIR}/classes/*.bbclass"
BBFILE_COLLECTIONS += "kvm"
BBFILE_PATTERN_kvm := "^${LAYERDIR}/"
BBFILE_PRIORITY_kvm = "7"

#To get target toolchain 
# We have a pre-populated downloads directory, add to PREMIRRORS
PREMIRRORS_append := " \
     git://.*/.* file://${LAYERDIR}/downloads/ \n \
     svn://.*/.* file://${LAYERDIR}/downloads/ \n \
     ftp://.*/.* file://${LAYERDIR}/downloads/ \n \
     http://.*/.* file://${LAYERDIR}/downloads/ \n \
     https://.*/.* file://${LAYERDIR}/downloads/ \n"

BB_NO_NETWORK ?= "0"
#to create guest rootfs img, raw and qcow2.
```
